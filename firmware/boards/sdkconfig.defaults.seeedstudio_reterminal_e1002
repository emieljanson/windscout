## firmware/boards/sdkconfig.defaults.seeedstudio_reterminal_e100x
```kconfig
# Seeed Studio reTerminal E1001/E1002 universal carrier
CONFIG_BOARD_DRIVER_SEEEDSTUDIO_RETERMINAL_E100X=y

CONFIG_ESPTOOLPY_FLASHSIZE_32MB=y
CONFIG_ESPTOOLPY_FLASHSIZE="32MB"
CONFIG_ESPTOOLPY_FLASHFREQ_80M=y
CONFIG_USE_INTERNAL_FLASH_STORAGE=y

CONFIG_ESP_CONSOLE_UART_DEFAULT=y
CONFIG_ESP_CONSOLE_SECONDARY_NONE=y
# CONFIG_ESP_CONSOLE_SECONDARY_USB_SERIAL_JTAG is not set
```

## firmware/components/epaper_driver_uc8179/Kconfig
```kconfig
config EP_DRIVER_UC8179_GRAY4_EXPERIMENTAL
    bool "Experimental UC8179 Gray4 external-LUT driver"
    help
        E1001 Gray4 transport ported from the pinned Seeed reference. This
        external-LUT waveform remains experimental until the U7 physical
        panel matrix accepts refresh quality, sleep/wake, and recovery.
```
